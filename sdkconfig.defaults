## sdkconfig.defaults
```kconfig
# ESP32-S3 Target Configuration
CONFIG_IDF_TARGET_ESP32S3=y

# USB Host Configuration
CONFIG_USB_HOST_ENABLE=y
CONFIG_USB_HOST_CONTROL_TRANSFER_MAX_SIZE=256
CONFIG_USB_HOST_HW_BUFFER_BIAS_BALANCED=y

# Flash Configuration for ESP32-S3-DevKitC-1 (8MB standard variant)
CONFIG_ESPTOOLPY_FLASHSIZE_8MB=y
CONFIG_ESPTOOLPY_FLASHMODE_QIO=y
CONFIG_ESPTOOLPY_FLASHFREQ_80M=y

# Partition table for 8MB flash
CONFIG_PARTITION_TABLE_SINGLE_APP_LARGE=y

# Main task stack size (increased for USB Host)
CONFIG_ESP_MAIN_TASK_STACK_SIZE=8192

# Log level
CONFIG_LOG_DEFAULT_LEVEL_INFO=y

# WiFi Configuration (802.11 b/g/n 2.4GHz as per specs)
CONFIG_ESP_WIFI_ENABLED=y
CONFIG_ESP_WIFI_STATIC_RX_BUFFER_NUM=10
CONFIG_ESP_WIFI_DYNAMIC_RX_BUFFER_NUM=32
CONFIG_ESP_WIFI_TX_BUFFER_TYPE_DYNAMIC=y
CONFIG_ESP_WIFI_DYNAMIC_TX_BUFFER_NUM=32

# Bluetooth Configuration (BT 5.0 + BLE 5.0 as per specs)
CONFIG_BT_ENABLED=y
CONFIG_BT_BLE_ENABLED=y
CONFIG_BT_BLUEDROID_ENABLED=y

# FreeRTOS Configuration (dual-core 240MHz as per specs)
CONFIG_FREERTOS_HZ=1000
CONFIG_FREERTOS_UNICORE=n

# HTTP Server
CONFIG_ESP_HTTP_SERVER_ENABLE=y

# PSRAM Configuration (ESP32-S3 with 8MB flash typically has PSRAM)
CONFIG_SPIRAM_SUPPORT=y
CONFIG_SPIRAM_BOOT_INIT=y
CONFIG_SPIRAM_USE_MALLOC=y
CONFIG_SPIRAM_TYPE_AUTO=y
CONFIG_SPIRAM_ALLOW_BSS_SEG_EXTERNAL_MEMORY=y

# Memory optimization for 8MB flash
CONFIG_ESP_SYSTEM_ALLOW_RTC_FAST_MEM_AS_HEAP=y
CONFIG_COMPILER_OPTIMIZATION_SIZE=y

# Console configuration
CONFIG_ESP_CONSOLE_UART_DEFAULT=y
CONFIG_ESP_CONSOLE_UART_NUM=0

# Performance optimizations for 240MHz CPU
CONFIG_ESP_DEFAULT_CPU_FREQ_MHZ_240=y
CONFIG_ESP_DEFAULT_CPU_FREQ_MHZ=240

# Enhanced security features
CONFIG_SECURE_BOOT=n
CONFIG_SECURE_FLASH_ENC_ENABLED=n 
```
